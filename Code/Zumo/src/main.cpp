#include <Arduino.h>
#include <Wire.h>
#include <SPI.h>

#ifdef A_STAR
#define ZERO 127
#define FACTOR_JOYSTICK 1.57
#define FACTOR 3.15
#include <Zumo32U4.h>
#include <FastGPIO.h>
#include <SoftwareSerial.h>

SoftwareSerial mySerial(IO_B3, IO_C7);
Zumo32U4Motors motors;
Zumo32U4OLED display;

uint64_t time = 0;

const uint8_t PROGMEM myBitmap [1024]  = {
	// 'PCKZiU_logo_Bit, 128x64px
	0x00, 0x00, 0x00, 0x00, 0x00, 0x00, 0x00, 0x00, 0x00, 0x00, 0x00, 0x00, 0x00, 0x00, 0x00, 0x00, 
	0x00, 0x00, 0x00, 0x00, 0x00, 0x00, 0x00, 0x00, 0x00, 0x00, 0x00, 0x00, 0x00, 0x00, 0x00, 0x00, 
	0x00, 0x00, 0x00, 0x00, 0x00, 0x00, 0x00, 0x00, 0x00, 0x00, 0x00, 0x00, 0x00, 0x00, 0x00, 0x00, 
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	0x00, 0x00, 0x00, 0x00, 0x00, 0x00, 0x00, 0x00, 0x00, 0x00, 0x00, 0x00, 0x00, 0x00, 0x00, 0x00
};

void displayBitmap(const uint8_t *bitmap) 
{
    for (uint16_t i = 0; i < 1024; i++) 
        display.write(pgm_read_byte(bitmap + i));
    display.display();
}

int16_t mapSpeed(uint8_t val, bool formJoystick)
{
    if(formJoystick)
    {
        if (val > ZERO) return (int16_t)ceil(FACTOR_JOYSTICK * (val - ZERO + 1) + 1) * -1;
        else if (val < ZERO) return (int16_t)floor(FACTOR_JOYSTICK * (val - ZERO - 1) - 1) * -1;
        else return 0;
    }
    else
    {
        if (val > ZERO) return (int16_t)ceil(FACTOR * (val - ZERO + 1) + 1);
        else if (val < ZERO) return (int16_t)floor(FACTOR * (val - ZERO - 1) - 1);
        else return 0;
    }
}

void steerMotors(uint8_t left, uint8_t right, bool formJoystick = false)
{
    motors.setRightSpeed(mapSpeed(right,formJoystick));
    motors.setLeftSpeed(mapSpeed(left, formJoystick));
}

#else
#include <SoftSPI.h>
#include <PS2X_lib.h>

uint8_t error;
uint8_t type;

PS2X ps2x;
#endif

void setup() {
    #ifdef A_STAR
    //Serial.begin(9600);
    mySerial.begin(9600);
    display.clear();              
    displayBitmap(myBitmap);
    steerMotors(ZERO,ZERO);

    #else
    Serial.begin(9600);
    error = ps2x.config_gamepad(13,11,10,12, true, true);
    type =  ps2x.readType();
    #endif
}

void loop() {
    #ifdef A_STAR
    if (mySerial.available() != 0) {
        String dataStr = mySerial.readStringUntil(';');
        dataStr.trim();
        //Read data
        uint8_t commaCount = 0;
        uint8_t lastComma = 0;
        uint8_t data[8] = {};
        for (uint8_t i = 0; i < dataStr.length(); i++)
            if (dataStr[i] == ',') 
            {
                commaCount++;
                if (commaCount > 7) return;
                data[commaCount - 1] = dataStr.substring(lastComma, i).toInt();
                lastComma = i + 1;
            }
        data[7] = dataStr.substring(lastComma, dataStr.length()).toInt();
        
        /*Serial.println(data[2]);
        Serial.println(data[3]);
        Serial.println(data[0]);
        Serial.println(data[1]);
        Serial.println(data[4]);
        Serial.println(data[6]);*/

        //SterMotors
        if(data[2] == 255) steerMotors(255, 0);//Right
        else if(data[3] == 255) steerMotors(0, 255); //Left 
        else if(data[0] == 255) steerMotors(255,255); //Up
        else if(data[1] == 255) steerMotors(0,0); //Down
        else steerMotors(data[4], data[6], true); //Joystick
        time = millis();
    }
    else if (time + 250 < millis()) steerMotors(ZERO,ZERO);
    #else
    if(type == 1 && error == 0)
    {
        ps2x.read_gamepad();

        Serial.print(ps2x.Analog(PSAB_PAD_UP), DEC);
        Serial.print(",");
        Serial.print(ps2x.Analog(PSAB_PAD_DOWN), DEC);
        Serial.print(",");
        Serial.print(ps2x.Analog(PSAB_PAD_RIGHT), DEC);
        Serial.print(",");
        Serial.print(ps2x.Analog(PSAB_PAD_LEFT), DEC);
        Serial.print(",");
        Serial.print(ps2x.Analog(PSS_LY), DEC);  
        Serial.print(",");
        Serial.print(ps2x.Analog(PSS_LX), DEC); 
        Serial.print(",");
        Serial.print(ps2x.Analog(PSS_RY), DEC); 
        Serial.print(",");
        Serial.print(ps2x.Analog(PSS_RX), DEC); 
        Serial.println(";");
    }
    #endif
}